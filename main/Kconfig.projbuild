## main/Kconfig.projbuild
```kconfig
menu "AVB Example Configuration"
    
    config EXAMPLE_AVB_ENTITY_NAME
        string "Entity Name"
        default "AVB Example Entity"
        help
            Set the name of the AVB entity. This name will be used 
            to identify this device in the AVB network.

    config EXAMPLE_AVB_MODEL_ID
        hex "Model ID"
        default 0x0000007468696e67
        help
            Set the model ID for this AVB entity. This ID should uniquely identify 
            the model/type of AVB device within your vendor's product line.

    config EXAMPLE_AVB_TALKER
        bool "Enable AVB Talker"
        default y
        help
            Function as AVB Talker.

    config EXAMPLE_AVB_TALKER_AUTO_STREAM
        bool "Auto Stream"
        depends on EXAMPLE_AVB_TALKER
        default n
        help
            Automatically start streaming when link is up. (not implemented yet)
      
    choice EXAMPLE_SELECT_MIC_GAIN
        prompt "Default MIC gain"
        depends on EXAMPLE_AVB_TALKER
        default MIC_GAIN_6DB
        help
            Select a codec-independent default mic gain. The AVB component
            clamps and rounds this to the nearest value supported by the
            selected codec.

        config MIC_GAIN_0DB
            bool "0 dB"
        config MIC_GAIN_6DB
            bool "6 dB"
        config MIC_GAIN_12DB
            bool "12 dB"
        config MIC_GAIN_18DB
            bool "18 dB"
        config MIC_GAIN_24DB
            bool "24 dB"
    endchoice
      
    config EXAMPLE_AVB_MIC_GAIN_TENTH_DB
        depends on EXAMPLE_AVB_TALKER
        int
        default 0 if MIC_GAIN_0DB
        default 60 if MIC_GAIN_6DB
        default 120 if MIC_GAIN_12DB
        default 180 if MIC_GAIN_18DB
        default 240 if MIC_GAIN_24DB

    config EXAMPLE_AVB_LISTENER
        bool "Enable AVB Listener"
        default y
        help
            Function as AVB Listener.

    config EXAMPLE_AVB_LISTENER_AUTO_CONNECT
        bool "Auto Connect"
        depends on EXAMPLE_AVB_LISTENER
        default n
        help
            Automatically connect to an AVB Talker with the same entity model ID. (not implemented yet)
      
    config EXAMPLE_AVB_SPEAKER_VOL_TENTH_DB
        int "Default speaker volume (tenths of dB)"
        depends on EXAMPLE_AVB_LISTENER
        range -955 0
        default -100
        help
            Set a codec-independent default speaker digital volume in tenths
            of dB. For example, -100 is -10.0 dB and 0 is 0.0 dB. The AVB
            component clamps and rounds this to the nearest value supported
            by the selected codec.

    config EXAMPLE_AVB_REMOTE_CONTROL
        bool "Allow remote control via ATDECC"
        default y
        help
            Allow an AVB Controller to control this device via ATDECC protocol. If not set it will break Milan compliance.

endmenu
```

## sdkconfig.defaults.esp32c6
```kconfig
# Wireless endpoint overrides — selected when building with
# IDF_TARGET=esp32c6 (e.g. for ESP3, the C6 + onboard ES8311 test board).
# Chained on top of sdkconfig.defaults; only the target-specific
# divergences belong here.

# Per-port topology — esp_ptp is the single source of truth; the
# matching ESP_AVB_* mirrors are derived in esp_avb/Kconfig.projbuild.
#   port 0: wifi (native on-chip radio, host_if=ahb), primary endpoint,
#           STA mode, ~150 Mbps negotiated cap.
# Phase 6a brought up Wi-Fi + beacon-IE consumer + FTM initiator;
# Phase 6b runs the full AVB stack on this port.
CONFIG_ESP_PTP_NUM_PORTS=1
CONFIG_ESP_PTP_PORT0_MEDIUM_WIFI=y
CONFIG_ESP_PTP_PORT0_HOST_IF_AHB=y
CONFIG_ESP_PTP_PORT0_TYPE_PRIMARY=y
CONFIG_ESP_PTP_PORT0_WIFI_MODE_STA=y
CONFIG_ESP_PTP_PORT0_LINK_SPEED_MBPS=150

# Disable listener fast-connect on this build — it interferes with the
# Phase 3 class-selection demo by re-binding with default (Class A) flags
# within milliseconds of any controller-driven disconnect. Test-only.
CONFIG_ESP_AVB_DISABLE_FAST_CONNECT=y

# FTM: initiator on STA per IEEE 802.1AS-2020 §12.1.2 (slave initiates).
# Responder also enabled so this board can serve as the AP-side test
# peer during development. ESP_WIFI_FTM_ENABLE must be y for the
# *_SUPPORT children to take effect.
CONFIG_ESP_WIFI_FTM_ENABLE=y
CONFIG_ESP_WIFI_FTM_INITIATOR_SUPPORT=y
CONFIG_ESP_WIFI_FTM_RESPONDER_SUPPORT=y
CONFIG_ESP_WIFI_SOFTAP_SUPPORT=n
```
